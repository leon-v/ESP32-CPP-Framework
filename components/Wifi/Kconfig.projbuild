## components/Wifi/Kconfig.projbuild
```kconfig
menu "WiFi AP Configuration"

    config ESP_WIFI_SSID
        string "WiFi SSID"
        default "ESP32Config"
        help
            SSID (network name) for the ESP32 to access point to use when in config mode.

    config ESP_WIFI_PASSWORD
        string "WiFi Password"
        default "ESP32Config"
        help
            WiFi password (WPA or WPA2) for the ESP32 to access point to use when in config mode.
    config ESP_WIFI_CHANNEL
        int "WiFi Channel"
        range 1 13
        default 1
        help
            WiFi channel (network channel) for the ESP32 to access point to use when in config mode.

    config ESP_MAX_STA_CONN
        int "Maximal STA connections"
        default 1
        help
            Maximum number of the clients that can connect in access point mode.
endmenu
```
